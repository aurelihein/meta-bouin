## conf/distro/bouin.conf
```bitbake
require conf/distro/poky.conf

DISTRO = "bouin"
DISTRO_NAME = "Aurelien BOUIN distro"
DISTRO_VERSION = "1.0"

SDK_VENDOR = "-bouinsdk"
SDK_VERSION := "${@'${DISTRO_VERSION}'.replace('snapshot-${DATE}','snapshot')}"

MAINTAINER = "Aurelien BOUIN <aurelien.bouin@captina.dev>"

IMAGE_FSTYPES = "${@d.getVar("BB_IMAGE_FSTYPES", expand=True) if d.getVar("BB_IMAGE_FSTYPES", True) else "ext4 wic.gz"}"
WKS_FILE = "sdimage-raspberrypi-bouin.wks"

#Customize Partition Name
BOOTDD_VOLUME_ID ?= "BootBouin"

DISTRO_FEATURES +="${DISTRO_FEATURES_DEFAULT} ${POKY_DEFAULT_DISTRO_FEATURES}"
DISTRO_FEATURES_class-native = "${DISTRO_FEATURES_DEFAULT} ${POKY_DEFAULT_DISTRO_FEATURES}"
DISTRO_FEATURES_class-nativesdk = "${DISTRO_FEATURES_DEFAULT} ${POKY_DEFAULT_DISTRO_FEATURES}"

# Add systemd
DISTRO_FEATURES += "systemd"
DISTRO_FEATURES_BACKFILL_CONSIDERED = "sysvinit"
VIRTUAL-RUNTIME_init_manager = "systemd"
VIRTUAL-RUNTIME_dev_manager = "systemd"

IMAGE_ROOTFS_EXTRA_SPACE_append = "${@bb.utils.contains("DISTRO_FEATURES", "systemd", " + 4096", "" ,d)}"
IMAGE_FEATURES += "splash"
SPLASH = "psplash-bouin"
IMAGE_FEATURES += "ssh-server-dropbear"
IMAGE_FEATURES += "package-management"

PACKAGE_CLASSES = "package_ipk"
#opkg package manager upgrade
#inside tmp/deploy/ipk
#run:
#sudo python -m SimpleHTTPServer 80
#Do not forget to do :
#bitbake package-index
PACKAGE_FEED_URIS ?= "http://pms.captina.dev:8000"
PACKAGE_FEED_BASE_PATHS ?= ""

# Add build information into /etc/build:
INHERIT += "image-buildinfo"
BUILDID ??= "#0"
IMAGE_BUILDINFO_VARS = "MAINTAINER DISTRO DISTRO_VERSION DATETIME BUILDID"
```

## conf/layer.conf
```bitbake
# We have a conf and classes directory, add to BBPATH
BBPATH .= ":${LAYERDIR}"

# We have recipes-* directories, add to BBFILES
BBFILES += "${LAYERDIR}/recipes-*/*/*.bb \
	${LAYERDIR}/recipes-*/*/*.bbappend"

# Handle dynamic-layers
# BBFILE_COLLECTIONS name of the repo
BBFILES_DYNAMIC += " \
    odroid-layer:${LAYERDIR}/dynamic-layers/odroid-layer/*/*/*.bb \
    odroid-layer:${LAYERDIR}/dynamic-layers/odroid-layer/*/*/*.bbappend \
    \
    raspberrypi:${LAYERDIR}/dynamic-layers/raspberrypi-layer/*/*/*.bb \
    raspberrypi:${LAYERDIR}/dynamic-layers/raspberrypi-layer/*/*/*.bbappend \
    \
"

BBFILE_COLLECTIONS += "bouin"
BBFILE_PATTERN_bouin = "^${LAYERDIR}/"
BBFILE_PRIORITY_meta-bouin = "10"
LAYERVERSION_bouin = "1"

LAYERSERIES_COMPAT_bouin = "zeus"
```

## conf/machine/raspberrypi3-64-mesa.conf
```bitbake
require conf/machine/raspberrypi3-64.conf

MACHINEOVERRIDES .= ":raspberrypi3-64"

MACHINE_FEATURES += "vc4graphics"
#Seems not required :
#DISTRO_FEATURES += "opengl"
#DISTRO_FEATURES += "egl"
#DISTRO_FEATURES += "pam"

GPU_MEM_256 = "128"
GPU_MEM_512 = "196"
GPU_MEM_1024 = "256"
#GPU_MEM_1024 = "396"

RPI_EXTRA_CONFIG = "dtparam=pwr_led_trigger=heartbeat"

IMAGE_FEATURES += "hwcodecs"

PACKAGE_FEED_ARCHS ?= "all aarch64 raspberrypi3_64_mesa"
```

## conf/machine/raspberrypi3-64-userland.conf
```bitbake
require conf/machine/raspberrypi3-64.conf

MACHINEOVERRIDES .= ":raspberrypi3-64"


MACHINE_FEATURES_remove = "vc4graphics"
#Seems not required :
#DISTRO_FEATURES += "opengl"
#DISTRO_FEATURES += "egl"
#DISTRO_FEATURES += "pam"
# EGL
DISTRO_FEATURES_remove = "wayland"
DISTRO_FEATURES_remove = "x11"

PACKAGECONFIG_remove_pn-wpewebkit = "wayland"
PACKAGECONFIG_remove_pn-wpewebkit = "gst_gl"
PACKAGECONFIG_remove_pn-wpewebkit = "video"
PACKAGECONFIG_remove_pn-wpewebkit = "webaudio"
PACKAGECONFIG_append_pn-wpewebkit = " egl"
PREFERRED_PROVIDER_virtual/wpebackend = "wpebackend-rdk"
PACKAGECONFIG_pn-wpebackend-rdk = "rpi libinput"
PACKAGECONFIG_remove_pn-gstreamer1.0-plugins-bad = "vulkan"

GPU_MEM_256 = "128"
GPU_MEM_512 = "196"
GPU_MEM_1024 = "256"
#GPU_MEM_1024 = "396"

RPI_EXTRA_CONFIG = "dtparam=pwr_led_trigger=heartbeat"

PACKAGE_FEED_ARCHS ?= "all aarch64 raspberrypi3_64_userland"
```

## wic/sdimage-raspberrypi-bouin.wks
```
# short-description: Create Raspberry Pi SD card image
# long-description: Creates a partitioned SD card image for use with
# Raspberry Pi. Boot files are located in the first vfat partition.

part /boot --source bootimg-partition --ondisk mmcblk0 --fstype=vfat --label bootbouin --active --align 4096 --size 20
part / --source rootfs --ondisk mmcblk0 --fstype=ext4 --label root --align 4096 --fixed-size 3G
#part / --source rootfs --ondisk mmcblk0 --fstype=ext4 --label root --align 4096
#part /userdata --ondisk mmcblk0 --fstype=ext4 --label userdata --active --align 4096 --size 1G
```
